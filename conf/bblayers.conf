## conf/bblayers.conf
```bitbake
# LAYER_CONF_VERSION is increased each time build/conf/bblayers.conf
# changes incompatibly
POKY_BBLAYERS_CONF_VERSION = "2"

BBPATH = "${TOPDIR}"
BBFILES ?= ""

BBLAYERS ?= " \
  /home/xbuild/poky/meta \
  /home/xbuild/poky/meta-poky \
  /home/xbuild/poky/meta-yocto-bsp \
  /home/xbuild/poky/meta-openembedded/meta-oe \
  /home/xbuild/poky/meta-openembedded/meta-python \
  /home/xbuild/poky/meta-openembedded/meta-networking \
  /home/xbuild/poky/meta-openembedded/meta-filesystems \
  /home/xbuild/poky/meta-openembedded/meta-webserver \
  /home/xbuild/poky/meta-suda \
  "
BBLAYERS_NON_REMOVABLE ?= " \
  /home/xbuild/poky/meta \
  /home/xbuild/poky/meta-poky \
  "
```
